## drivers/input/asusec/Kconfig
```kconfig
#
# Asus input device configuration
#

config INPUT_ASUSEC
	bool "ASUS embedded controller interface"
	depends on I2C
	help
	  Say Y here to enable support for Asus embedded controller interface.
	  This config is base, needed by PAD and DOCK controller interfaces
	  used in Asus Transformer Series.

config ASUSPEC
	bool "ASUS PAD controller interface"
	depends on INPUT_ASUSEC
	help
	  Say Y here to enable support for Asus PAD controller interface.
	  Main purpose of this driver is to read and control PAD controller
	  interface, which provides information about battery state, charging
	  process, pad state and firmware version.

config ASUSDEC
	bool "ASUS DOCK controller interface"
	depends on INPUT_ASUSEC
	help
	  Say Y here to enable support for Asus DOCK controller interface.
	  Main purpose of this driver is to work with keyboard and touchpad,
	  additionally it provides information about dock battery state,
	  charging process and firmware version.

config BATTERY_PAD
	tristate "PAD battery driver"
	depends on I2C && ASUSPEC
	help
	  Say Y here to enable support for battery driver in Asus Transformers.
	  This driver takes data from Asus EC driver and highly depends from it.
	  Batteries are based on BQ20Z45 chip.
```
